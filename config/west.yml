## config/west.yml
```yaml
manifest:
  remotes:
    - name: zmkfirmware
      url-base: https://github.com/zmkfirmware
    - name: ergonautkb
      url-base: https://github.com/ergonautkb
  projects:
    - name: zmk
      remote: zmkfirmware
      revision: acfd8e5ea76cf23ad1c9b6b99848f97a95224257  # v0.3-branch
      import: app/west.yml
    - name: ergonautkb-zmk-module
      remote: ergonautkb
      revision: 0baf6fb036595f4c16bde895b8804123e6b4cf0d  # main
  self:
    path: config
```
